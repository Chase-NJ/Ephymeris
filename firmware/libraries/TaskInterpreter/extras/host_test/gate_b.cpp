/*  GATE B — the interpreter must emit exactly what runTrial() emits.
 *
 *  THE CRUX OF THE PROJECT. Everything before this is preparation; everything
 *  after is comparatively mechanical. Replacing a hand-verified trial loop with a
 *  table interpreter is a change nobody can partially trust: either the two
 *  provably agree, or the lab keeps flashing the old firmware and this work dies
 *  at 90% complete.
 *
 *  ------------------------------------------------------------------------
 *  WHAT IS COMPARED AGAINST WHAT
 *
 *  Against the MODEL table (template v2). Firmware has shipped the three changes
 *  in docs/firmware-changes.md, so the two questions this gate once had to keep
 *  apart -- "is the interpreter correct" and "has firmware caught up" -- have
 *  collapsed into one, with one answer: byte-identity, and no allowances.
 *
 *  It used to tolerate exactly one class of difference, the inverted well-unpoke
 *  wait. That allowance is gone rather than merely unused. An allowance nobody
 *  needs is an allowance nobody re-reads, and it would quietly absorb the next
 *  bug that happened to shift the same timestamps.
 *
 *  The as-built table (v1) is still generated and -DTG_TABLE_HEADER still selects
 *  it, because the RECORDED CORPUS predates the firmware change and is validated
 *  against v1 (tests/test_corpus_replay.py).
 *
 *  ------------------------------------------------------------------------
 *  WHY THE BATTERY IS RANDOMISED
 *
 *  Hand-written cases test what the author thought of. The interesting failures
 *  in a trial loop are boundaries -- a hold released one poll before it completes,
 *  a response landing on the last millisecond of its window -- and those are found
 *  by generating thousands of animals, not by imagining them.
 *
 *  Deterministic: one seed, printed, so any failure is reproducible exactly.
 */

#include <cstdio>
#include <cstring>
#include <vector>

#include "Arduino.h"

MockBox mock;

/*  Both tables are generated by taskgraph/emit/c_table.py and expose the same
    symbol, so which graph the battery walks is a -D away and never a code edit.
    grgl_table.h is specs/grgl_2odor.yaml (v2, the model, and now the firmware);
    asbuilt_table.h is tests/fixtures/grgl_2odor_asbuilt.yaml (v1, what the
    recorded corpus was produced by). */
#ifndef TG_TABLE_HEADER
#define TG_TABLE_HEADER "grgl_table.h"
#endif
#include TG_TABLE_HEADER

#include "battery.h" // the shared randomised animal; needs TG_IDX_* above

/* GRGL's two trial types, verbatim from GRGL_2-Odor.ino:43-59. Index order
   matches contingency.trial_types, which is what makes trial N mean the same
   thing to both implementations. */
static const TrialType goRight1(true, Odors[0], rightWell, RIGHT_WELL_FL_1,
                                BF_ODOR_1_ON, BF_FLUID_R, BF_STOP_FLUID_G_R);
static const TrialType goLeft1(true, Odors[2], leftWell, LEFT_WELL_FL_1,
                               BF_ODOR_3_ON, BF_FLUID_L, BF_STOP_FLUID_G_L);
static const TrialType *TRIALS[] = {&goRight1, &goLeft1};

/* ---------------------------------------------------------------- *
 *  Comparison
 * ---------------------------------------------------------------- */

static const char *nameOf(int c)
{
  switch (c)
  {
  case 101: return "ODOR_1_ON";        case 103: return "ODOR_3_ON";
  case 222: return "LIGHTS_ON";        case 223: return "LAZY_RAT";
  case 224: return "ODOR_POKE";        case 225: return "ODOR_UNPOKE_EARLY";
  case 226: return "ODOR_UNPOKE";      case 233: return "LIGHTS_OFF";
  case 234: return "INVALID_TRIAL";    case 242: return "END_CORRECT_ITI";
  case 243: return "END_INCORRECT_ITI"; case 247: return "ODOR_OFF";
  case 248: return "WATER_POKE_L";     case 249: return "WATER_POKE_R";
  case 250: return "WATER_UNPOKE_EARLY_L"; case 251: return "WATER_UNPOKE_EARLY_R";
  case 252: return "FLUID_L";          case 253: return "FLUID_R";
  case 254: return "WATER_UNPOKE_L";   case 255: return "WATER_UNPOKE_R";
  case 257: return "WATER_POKE_ERROR_L"; case 258: return "WATER_POKE_ERROR_R";
  case 262: return "RESP_OMIT";
  case 357: return "STOP_FLUID_G_R";   case 369: return "STOP_FLUID_G_L";
  default: return "?";
  }
}

static void dump(const char *label, const std::vector<MockEvent> &v)
{
  std::printf("      %-12s", label);
  for (const auto &e : v)
    std::printf(" %s@%lu", nameOf(e.code), e.t);
  std::printf("\n");
}

int main(int argc, char **argv)
{
  const unsigned long seed = (argc > 1) ? std::strtoul(argv[1], 0, 10) : 20260803UL;
  const int nTrials = (argc > 2) ? std::atoi(argv[2]) : 4000;

  Rng rng{seed};
  int diverged = 0, checked = 0, hangs = 0, hungRunTrial = 0, hungInterp = 0;
  int outcomes[6] = {0, 0, 0, 0, 0, 0}; // correct, wrong, omission, abstain, brk, holdfail

  for (int i = 0; i < nTrials; i++)
  {
    /*  Walk the stage ramp as a real session does, so the boundaries where the
        four live holds change are inside the battery rather than outside it. */
    TaskParams p;
    clampTaskParams(p);
    applyStage(p, (int)rng.in(0, 120));

    const Script s = drawScript(rng, p);

    /* --- the reference ------------------------------------------------- */
    arm(s);
    TrialClock clkA;
    clkA.beginSession();
    bool advA = false, hungA = false;
    unsigned long hungAt = 0;
    try { advA = runTrial(*TRIALS[s.trial], p, clkA, nullptr, 0); }
    catch (const MockHang &h) { hungA = true; hungAt = h.at; }
    /*  The sketch loop, not runTrial(), emits INVALID_TRIAL when a trial does not
        advance (GRGL_2-Odor.ino:175). The interpreter models the whole trial
        INCLUDING its terminal, so the reference side has to include the sketch's
        contribution or the comparison is against two different things. */
    if (!hungA && !advA)
      emitStrobe(clkA, BF_INVALID_TRIAL);
    const std::vector<MockEvent> a = mock.emitted;

    /* --- the interpreter, on the same world ----------------------------- */
    arm(s);
    TrialClock clkB;
    clkB.beginSession();
    TgTable table = TG_TABLE;
    /*  Layer-3 values the ramp rewrites, moved in both places at once. */
    syncTiming(table, p);

    TgRun run;
    bool advB = false, hungB = false;
    try { advB = tgRunTrial(table, run, p, clkB, s.trial); }
    catch (const MockHang &) { hungB = true; }
    const std::vector<MockEvent> b = mock.emitted;

    if (hungA || hungB)
    {
      if (hangs < 3)
      {
        std::printf("  HANG  %s did not terminate at t=%lu ms\n",
                    hungA ? (hungB ? "BOTH" : "runTrial") : "interpreter", hungAt);
        std::printf("        trial=%u engage=%lu..%lu resp=%d %lu..%lu\n",
                    s.trial, s.engageAt, s.engageTo, s.respPin, s.respAt, s.respTo);
        dump(hungA ? "runTrial" : "interpreter", hungA ? a : b);
      }
      hangs++;
      hungRunTrial += hungA ? 1 : 0;
      hungInterp += hungB ? 1 : 0;
      continue;
    }

    checked++;
    /* Tally what the battery actually exercised, from the reference stream. */
    for (const auto &e : a)
    {
      if (e.code == 242) outcomes[0]++;
      else if (e.code == 257 || e.code == 258) outcomes[1]++;
      else if (e.code == 223) outcomes[3]++;
      else if (e.code == 225) outcomes[4]++;
      else if (e.code == 250 || e.code == 251) outcomes[5]++;
    }
    /*  Counted off RESP_OMIT now that firmware emits it. The v1 shape -- sampled,
        no poke code, ends incorrect -- is kept as a cross-check: the two must
        agree, or the code is being emitted somewhere it does not belong. */
    {
      bool sampled = false, poked = false, incorrect = false, omitted = false;
      for (const auto &e : a)
      {
        if (e.code == 226) sampled = true;
        if (e.code == 248 || e.code == 249) poked = true;
        if (e.code == 243) incorrect = true;
        if (e.code == 262) omitted = true;
      }
      if (omitted != (sampled && !poked && incorrect))
      {
        std::printf("  RESP_OMIT disagrees with the trial's shape (trial %d)\n", i);
        return 1;
      }
      if (omitted) outcomes[2]++;
    }

    bool same = (a.size() == b.size()) && (advA == advB);
    for (size_t k = 0; same && k < a.size(); k++)
      same = (a[k].code == b[k].code) && (a[k].t == b[k].t);

    if (!same && diverged < 5)
    {
      std::printf("  DIVERGENCE #%d  trial=%u engage=%lu..%lu resp=%d %lu..%lu\n",
                  diverged + 1, s.trial, s.engageAt, s.engageTo, s.respPin,
                  s.respAt, s.respTo);
      std::printf("      %-12s advance=%d\n", "runTrial", advA ? 1 : 0);
      dump("runTrial", a);
      std::printf("      %-12s advance=%d\n", "interpreter", advB ? 1 : 0);
      dump("interpreter", b);
    }
    if (!same)
      diverged++;
  }

  std::printf("seed=%lu trials=%d checked=%d diverged=%d\n", seed, nTrials, checked, diverged);
  std::printf("hangs=%d (runTrial=%d interpreter=%d)\n", hangs, hungRunTrial, hungInterp);
  std::printf("coverage correct=%d wrong=%d omission=%d abstain=%d holdbreak=%d holdfail=%d\n",
              outcomes[0], outcomes[1], outcomes[2], outcomes[3], outcomes[4], outcomes[5]);
  /*  The gate passes when NOTHING differs and NEITHER side hangs. A hang is a
      failure here rather than a skipped trial: a box that stops with an animal in
      it is the outcome this whole project is built to prevent, and `checked` is
      required to equal `trials` so a hang can never quietly shrink the sample the
      divergence count is drawn from. */
  return (diverged == 0 && hangs == 0) ? 0 : 1;
}
